#include <Arduino.h>
#include <SPI.h>
#include <Wire.h>
#include <Adafruit_GFX.h>
#include <Adafruit_SSD1306.h>

#include "pins.h"
#include "display.h"
#include "functions.h"
#include "measure.h"
#include "pitches.h"
#include "settings.h"

////////////Variables//////////////

#define SCREEN_WIDTH 128
#define SCREEN_HEIGHT 64
#define OLED_RESET -1

Adafruit_SSD1306 display(SCREEN_WIDTH, SCREEN_HEIGHT, &Wire, OLED_RESET);

unsigned int PageNumber = 0;

bool ForceDisplayUpdate = false;

unsigned int DischargePage = STD_DISCHARGE_PAGE;

const unsigned char LOGO_Bitmap [] PROGMEM = {  //128x64

	0x00, 0x00, 0x00, 0x00, 0x00, 0x00, 0x00, 0x00, 0x00, 0x00, 0x00, 0x00, 0x00, 0x00, 0x00, 0x00, 
	0x00, 0x00, 0x00, 0x00, 0x00, 0x00, 0x00, 0x00, 0x00, 0x00, 0x00, 0x00, 0x00, 0x00, 0x00, 0x00, 
	0x00, 0x00, 0x00, 0x00, 0x00, 0x00, 0x00, 0x00, 0x00, 0x00, 0x00, 0x00, 0x00, 0x00, 0x00, 0x00, 
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	0x00, 0x00, 0x00, 0x00, 0x00, 0x00, 0x00, 0x00, 0x00, 0x00, 0x00, 0x00, 0x00, 0x00, 0x00, 0x00
};


/////////////////////////////////

void DisplayInit() {
  if (!display.begin(SSD1306_SWITCHCAPVCC, DISPLAY_ADRESS)) {
    Serial.println(F("SSD1306 allocation failed"));
  }
  display.clearDisplay();
}

void DrawBootPage() {
  display.clearDisplay();
  display.display();

  if (CUSTOM_LOGO){
    display.drawBitmap(0, 0, LOGO_Bitmap, 128, 64, WHITE);
    
    display.display();
    delay(1500);
  }
  
  display.setTextSize(3);
  display.setTextColor(WHITE);
  display.setCursor(36, 11);
  display.println("BDC");

  display.setTextSize(1);
  display.setTextColor(WHITE);
  display.setCursor(0, 45);
  display.println("Dev. by Marvin Ramm");

  display.setTextSize(1);
  display.setTextColor(WHITE);
  display.setCursor(0, 55);
  display.print("V");
  display.println(VERSION);

  display.display();
  delay(1200);
}

void UpdateDisplay() {
  display.clearDisplay();
  

  display.setTextSize(1);
  display.setTextColor(WHITE);
  display.setCursor(0, 0);

  if (DischargeState == 0){
    display.println("Standby");
  }else if (DischargeState == 1){
    display.print("Discharge -> ");
    display.print(DischargeVoltage);
    display.println("V");
  }else{
    display.println("Done");
  }

  if (DischargeState != 1) {
    display.setTextSize(1);
    display.setTextColor(WHITE);
    display.setCursor(0, 12);
    display.print(AvgCellVoltage, 3);
    display.print("V");
  }else{
    if (DischargePage != 1){
      display.setTextSize(1);
    display.setTextColor(WHITE);
    display.setCursor(0, 12);
    display.print(AvgCellVoltage, 3);
    display.print("V ");
    if((DischargeVoltage - AvgCellVoltage) < 0){
      display.print(DischargeVoltage - AvgCellVoltage);
      display.println("V");
    }else{
      display.println("-0.00V");
    }
    
    }else{
      display.setTextSize(1);
      display.setTextColor(WHITE);
      display.setCursor(0, 12);
      display.print(BATVoltage, 3);
      display.print("V");
    }
  }

  display.setTextSize(1);
  display.setTextColor(WHITE);
  display.setCursor(115, 0);
  
if (CellType == 2){
    display.println("S2");
  }else if (CellType == 3){
    display.println("S3");
  }else if (CellType == 4){
    display.println("S4");
  }else if (CellType == 5){
    display.println("S5");
  }else if (CellType == 6){
    display.println("S6");
  }

  display.setTextSize(3);
  display.setTextColor(WHITE);
  if (DischargeState != 1) {
    display.setCursor(20, 31);
    display.print(DischargeVoltage);
    display.println("V");
  }else{
    if (DischargePage == 0){
      if (BATVoltage < 10.00){
    display.setCursor(20, 31);
  }else{
    display.setCursor(10 , 31);
  }
  display.print(BATVoltage);
  display.println("V");
  
  }else if (DischargePage == 1){
    display.setCursor(20, 31);
    display.print(AvgCellVoltage);
    display.println("V");
  }else{
    if (DischargePercent < 10){
      display.setCursor(50, 31);
    }else if ((DischargePercent >= 10) && (DischargePercent < 100)) {
      display.setCursor(40, 31);
    }else{
      display.setCursor(30, 31);
    }
    display.print(DischargePercent);
    display.println("%");
  }
  }
  

  display.display();
}
